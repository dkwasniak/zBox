## esp32/sdkconfig.defaults
```kconfig
# MusicBox sdkconfig.defaults
# Based on mirkosertic/ESP32MusicBox configuration

# --- Compiler ---
CONFIG_COMPILER_OPTIMIZATION_SIZE=y

# --- FreeRTOS ---
CONFIG_FREERTOS_HZ=1000

# --- Flash ---
CONFIG_ESPTOOLPY_FLASHMODE="dio"
CONFIG_ESPTOOLPY_FLASHFREQ="80m"
CONFIG_ESPTOOLPY_FLASHSIZE="4MB"
CONFIG_ESPTOOLPY_FLASHSIZE_4MB=y

# --- CPU ---
CONFIG_ESP_DEFAULT_CPU_FREQ_MHZ=240

# --- Bluetooth: Classic only (A2DP), no BLE - saves IRAM ---
CONFIG_BT_ENABLED=y
CONFIG_BT_BLUEDROID_ENABLED=y
CONFIG_BT_CLASSIC_ENABLED=y
CONFIG_BT_A2DP_ENABLE=y
CONFIG_BT_BLE_ENABLED=n
CONFIG_BTDM_CTRL_MODE_BR_EDR_ONLY=y

# --- SPIRAM/PSRAM (Lolin D32 Pro) ---
CONFIG_SPIRAM=y
CONFIG_SPIRAM_SPEED=80
CONFIG_SPIRAM_USE_MALLOC=y

# --- Bootloader ---
CONFIG_BOOTLOADER_LOG_LEVEL_NONE=y
CONFIG_BOOTLOADER_LOG_LEVEL=0

# --- Partition table ---
CONFIG_PARTITION_TABLE_CUSTOM=y
CONFIG_PARTITION_TABLE_CUSTOM_FILENAME="custom_4mb_ota.csv"

# --- Log level ---
CONFIG_LOG_DEFAULT_LEVEL_INFO=y
CONFIG_LOG_DEFAULT_LEVEL=3

# --- WiFi (needed for sync mode coexistence config) ---
CONFIG_ESP_WIFI_STATIC_RX_BUFFER_NUM=8
CONFIG_ESP_WIFI_DYNAMIC_RX_BUFFER_NUM=32
CONFIG_ESP_WIFI_DYNAMIC_TX_BUFFER_NUM=32

# --- LWIP ---
CONFIG_LWIP_MAX_SOCKETS=16

# --- FAT/SD: długie nazwy plików (polskie znaki, spacje) ---
CONFIG_FATFS_LFN_HEAP=y
CONFIG_FATFS_MAX_LFN=255

# --- Arduino ---
CONFIG_AUTOSTART_ARDUINO=y

# --- ESP Insights/RainMaker: disabled ---
CONFIG_ESP_INSIGHTS_ENABLED=n
```
